#include "corne_xiao_v2.dtsi"

&spi1 {
    status = "okay";

    nice_view: display@0 {
        compatible = "sharp,ls013b7dh06";
        reg = <0>; // Valid for #address-cells = <1>, #size-cells = <0>
        label = "NiceView";
        spi-max-frequency = <8000000>;
        cs-gpios = <&gpio0 2 GPIO_ACTIVE_LOW>;
        reset-gpios = <&gpio0 3 GPIO_ACTIVE_LOW>;
    };
};


&kscan0 {
    col-gpios
        = <&gpio0 10 GPIO_ACTIVE_HIGH>
        , <&xiao_d 10 GPIO_ACTIVE_HIGH>
        , <&xiao_d 3 GPIO_ACTIVE_HIGH>
        , <&xiao_d 8 GPIO_ACTIVE_HIGH>
        , <&xiao_d 6 GPIO_ACTIVE_HIGH>
        , <&xiao_d 7 GPIO_ACTIVE_HIGH>
        ;
};

&left_encoder {
    status = "okay";
};
